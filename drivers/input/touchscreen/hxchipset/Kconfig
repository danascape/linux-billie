## drivers/input/touchscreen/hxchipset/Kconfig
```kconfig
#
# Himax Touchscreen driver configuration
#

config TOUCHSCREEN_HIMAX_COMMON
        tristate "HIMAX chipset touchscreen"
		depends on TOUCHSCREEN_HIMAX_CHIPSET
		select REGMAP_I2C
		help
		This enables support for HIMAX CHIPSET touchscreens. The I2C
		bus is always supported; SPI is enabled separately via
		TOUCHSCREEN_HIMAX_SPI.

config TOUCHSCREEN_HIMAX_SPI
        bool "HIMAX chipset SPI bus support"
		depends on TOUCHSCREEN_HIMAX_COMMON && SPI_MASTER
		select REGMAP_SPI
		help
		This enables the SPI transport in the HIMAX common driver
		(in addition to the always-on I2C transport). Required for
		HIMAX no-flash variants such as HX83112F that ship on
		SPI-attached panels.

choice
	prompt "HIMAX touch IC types"
	depends on TOUCHSCREEN_HIMAX_COMMON
	default TOUCHSCREEN_HIMAX_INCELL

config TOUCHSCREEN_HIMAX_ONCELL
        bool "HIMAX chipset on-cell function"
		depends on TOUCHSCREEN_HIMAX_COMMON
		help
		This enables support for HIMAX CHIPSET of on-cell function.

config TOUCHSCREEN_HIMAX_INCELL
        bool "HIMAX chipset in-cell function"
		depends on TOUCHSCREEN_HIMAX_COMMON
		help
		This enables support for HIMAX CHIPSET of in-cell function.

endchoice

# ***************** On-cell Start *****************
config TOUCHSCREEN_HIMAX_IC_HX852xH
        tristate "HIMAX chipset HX852xH function"
		depends on TOUCHSCREEN_HIMAX_ONCELL
		help
		This enables support for HIMAX CHIPSET of HX852xH.

config TOUCHSCREEN_HIMAX_IC_HX852xG
        tristate "HIMAX chipset HX852xG function"
		depends on TOUCHSCREEN_HIMAX_ONCELL
		help
		This enables support for HIMAX CHIPSET of HX852xG.

# ***************** On-cell End *******************
# ***************** In-cell Start *****************
config TOUCHSCREEN_HIMAX_IC_HX83192
        tristate "HIMAX chipset HX83192 function"
		depends on TOUCHSCREEN_HIMAX_INCELL
		help
		This enables support for HIMAX CHIPSET of HX83192.

config TOUCHSCREEN_HIMAX_IC_HX83191
        tristate "HIMAX chipset HX83191 function"
		depends on TOUCHSCREEN_HIMAX_INCELL
		help
		This enables support for HIMAX CHIPSET of HX83191.

config TOUCHSCREEN_HIMAX_IC_HX83113
        tristate "HIMAX chipset HX83113 function"
		depends on TOUCHSCREEN_HIMAX_INCELL
		help
		This enables support for HIMAX CHIPSET of HX83113.

config TOUCHSCREEN_HIMAX_IC_HX83112
        tristate "HIMAX chipset HX83112 function"
		depends on TOUCHSCREEN_HIMAX_INCELL
		help
		This enables support for HIMAX CHIPSET of HX83112.

		The HX83112 chip handler also recognises the F revision
		(IC ID 0x83112F) and registers the SRAM-reload hooks
		needed for the no-flash variant. To actually drive a
		no-flash panel, also enable TOUCHSCREEN_HIMAX_NOFLASH.

config TOUCHSCREEN_HIMAX_NOFLASH
        bool "HIMAX no-flash (zero-flash) operation"
		depends on TOUCHSCREEN_HIMAX_INCELL
		help
		Enable the no-flash boot path. Variants such as HX83112F
		have no on-chip flash and reload firmware into SRAM on
		every boot/resume; the IC handler then calls
		fp_0f_reload_to_active() and friends through g_core_fp.

		This defines HX_ZERO_FLASH internally, which changes
		several driver-wide behaviours (resume reloads firmware,
		HX_TP_PROC_GUEST_INFO is disabled, DSRAM_SIZE is set,
		etc.). Leave disabled for flash-backed Himax panels.

config TOUCHSCREEN_HIMAX_IC_HX83111
        tristate "HIMAX chipset HX83111 function"
		depends on TOUCHSCREEN_HIMAX_INCELL
		help
		This enables support for HIMAX CHIPSET of HX83111.

config TOUCHSCREEN_HIMAX_IC_HX83106
        tristate "HIMAX chipset HX83106 function"
		depends on TOUCHSCREEN_HIMAX_INCELL
		help
		This enables support for HIMAX CHIPSET of HX83106.

config TOUCHSCREEN_HIMAX_IC_HX83103
        tristate "HIMAX chipset HX83103 function"
		depends on TOUCHSCREEN_HIMAX_INCELL
		help
		This enables support for HIMAX CHIPSET of HX83103.

config TOUCHSCREEN_HIMAX_IC_HX83102
        tristate "HIMAX chipset HX83102 function"
		depends on TOUCHSCREEN_HIMAX_INCELL
		help
		This enables support for HIMAX CHIPSET of HX83102.

# ***************** In-cell End *******************

config TOUCHSCREEN_HIMAX_DEBUG
        bool "HIMAX debug function"
		depends on TOUCHSCREEN_HIMAX_INCELL || TOUCHSCREEN_HIMAX_ONCELL
		help
		This enables support for HIMAX debug function.
config TOUCHSCREEN_HIMAX_INSPECT
        bool "HIMAX inspect function"
		depends on TOUCHSCREEN_HIMAX_INCELL || TOUCHSCREEN_HIMAX_ONCELL
		help
		This enables support for HIMAX debug function.

config TOUCHSCREEN_HIMAX_EMBEDDED_FIRMWARE
	bool "HIMAX embedded firmware function"
		depends on TOUCHSCREEN_HIMAX_INCELL || TOUCHSCREEN_HIMAX_ONCELL
		help
		This enables built-in FW inside kernel as binary array

config HMX_DB
	bool "HIMAX driver test over Dragon Board"
	depends on TOUCHSCREEN_HIMAX_COMMON
	help
	  This enables support for HIMAX driver test over Dragon Board.
```

## drivers/input/touchscreen/touchscreen_himax/Kconfig
```kconfig
source "drivers/input/touchscreen/touchscreen_himax/util_interface/Kconfig"
source "drivers/input/touchscreen/touchscreen_himax/himax/Kconfig"
```

## drivers/input/touchscreen/touchscreen_himax/himax/Kconfig
```kconfig
source "drivers/input/touchscreen/touchscreen_himax/himax/hx83112f_noflash/Kconfig"
```
